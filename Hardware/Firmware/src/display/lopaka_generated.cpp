#include "lopaka_generated.h"
#include <Arduino.h>

// ============================================================================
// LOPAKA ASSETS — TOP BAR
// ============================================================================
static const unsigned char PROGMEM image_topbar_back_bits[] = {0x20,0x00,0x60,0x00,0xff,0x00,0x60,0x80,0x20,0x40,0x00,0x40,0x00,0x80,0x1f,0x00};
static const unsigned char PROGMEM image_topbar_battery_case_bits[] = {0x00,0x00,0x00,0x0f,0xff,0xfe,0x10,0x00,0x01,0x10,0x00,0x01,0x70,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0x00,0x00};
static const unsigned char PROGMEM image_topbar_info_bits[] = {0x78,0xcc,0xcc,0x0c,0x18,0x30,0x00,0x30};
static const unsigned char PROGMEM image_topbar_network_connected_bits[] = {0x00,0x0e,0x00,0x0e,0x00,0x0e,0x00,0xee,0x00,0xee,0x00,0xee,0x00,0xee,0x0e,0xee,0x0e,0xee,0x0e,0xee,0x0e,0xee,0xee,0xee,0xee,0xee,0xee,0xee};
static const uint16_t PROGMEM image_topbar_margins_pixels[] = {0x0000,0x0000,0x0000,0x0000,0x0000,0x0000,0x0000,0x0000,0x0000,0x0000,0x0000,0x0000,0x0000,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0x7068,0x7068};

// ============================================================================
// LOPAKA ASSETS — MAIN MENU
// ============================================================================
static const unsigned char PROGMEM image_Layer_13_bits[] = {0xff,0xfc,0xff,0xfc,0x3f,0xf0,0x3f,0xf0,0x0f,0xc0,0x0f,0xc0,0x03,0x00,0x03,0x00};
static const unsigned char PROGMEM image_Layer_14_bits[] = {0x03,0x00,0x03,0x00,0x0f,0xc0,0x0f,0xc0,0x3f,0xf0,0x3f,0xf0,0xff,0xfc,0xff,0xfc};
static const unsigned char PROGMEM image_Layer_15_bits[] = {0xfe,0x7c,0x38,0x10};
static const unsigned char PROGMEM image_Layer_16_bits[] = {0x10,0x38,0x7c,0xfe};
static const unsigned char PROGMEM image_Layer_23_bits[] = {0xfe,0x00,0x00,0xfe,0x00,0x00,0xfe,0x00,0x00,0xfe};
static const unsigned char PROGMEM image_menu_selection_pill_bits[] = {0x00,0xff,0xff,0xff,0xff,0xff,0xff,0xff,0xff,0xff,0xff,0xff,0xff,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0xf8,0x00};

// Aliases for compatibility with Lopaka variable names
#define image_scrollbar_arrow_dn_large image_Layer_13_bits
#define image_scrollbar_arrow_up_large image_Layer_14_bits
#define image_scrollbar_arrow_dn_small image_Layer_15_bits
#define image_scrollbar_arrow_up_small image_Layer_16_bits

// Colors from Lopaka
#define COLOR_BG          0x0801
#define COLOR_ACCENT      0xE33F
#define COLOR_ACCENT_NET  0xE37F
#define COLOR_GREY_TRACK  0x6870
#define COLOR_GREY_INNER  0x506C
#define COLOR_TEXT_UNSEL  0x506C
#define COLOR_TEXT_SEL    0xE33F

// Menu layout constants
static const uint16_t ITEM_Y_POSITIONS[3]  = { 25, 97, 167 };
static const uint16_t TEXT_Y_POSITIONS[3]  = { 52, 125, 198 };
static const uint16_t ICON_Y_POSITIONS[3]  = { 36, 108, 181 };
static const uint16_t THUMB_Y_POSITIONS[3] = { 59, 106, 167 };
static const char*    MENU_LABELS[3]       = { "Workout Logs", "Music Queue", "Settings" };

// ============================================================================
// TOP BAR DRAWING
// ============================================================================
void draw_topbar() {
    // Layer 1: Margins/background frame drawn FIRST so it sits behind text/icons
    tft.pushImage(0, 0, 320, 21, image_topbar_margins_pixels);

    // Battery level fill inside case (75% default for Phase 1)
    tft.fillRect(296, 5, 12, 9, COLOR_ACCENT);

    // Battery case outline
    tft.drawBitmap(286, 2, image_topbar_battery_case_bits, 24, 16, COLOR_GREY_TRACK);

    // Time text
    tft.setTextColor(COLOR_ACCENT);
    tft.setTextSize(1);
    tft.drawString("12:23 PM", 75, 6);

    // Back icon
    tft.drawBitmap(10, 5, image_topbar_back_bits, 10, 8, COLOR_ACCENT);

    // Info icon
    tft.drawBitmap(45, 5, image_topbar_info_bits, 7, 8, COLOR_ACCENT);

    // Day & date text
    tft.drawString("Monday: 14th May", 140, 6);

    // Network connected icon
    tft.drawBitmap(252, 3, image_topbar_network_connected_bits, 15, 14, COLOR_ACCENT_NET);
}

// ============================================================================
// SCROLLBAR THUMB HELPER
// ============================================================================
static void draw_scrollbar_thumb(uint8_t sel) {
    uint16_t ty = THUMB_Y_POSITIONS[sel];
    tft.fillRect(303, ty, 9, 15, COLOR_ACCENT);

    if (sel == 0) {
        tft.drawLine(304, 62, 310, 62, COLOR_GREY_INNER);
        tft.drawLine(304, 65, 310, 65, COLOR_GREY_INNER);
        tft.drawLine(304, 68, 310, 68, COLOR_GREY_INNER);
        tft.drawLine(304, 71, 310, 71, COLOR_GREY_INNER);
    } else if (sel == 1) {
        tft.drawBitmap(304, 109, image_Layer_23_bits, 7, 10, COLOR_GREY_TRACK);
    } else {
        tft.drawLine(304, 170, 310, 170, COLOR_GREY_INNER);
        tft.drawLine(304, 173, 310, 173, COLOR_GREY_INNER);
        tft.drawLine(304, 176, 310, 176, COLOR_GREY_INNER);
        tft.drawLine(304, 179, 310, 179, COLOR_GREY_INNER);
    }
}

// ============================================================================
// SINGLE MENU ITEM RENDERER (draws or updates one item row)
// ============================================================================
static void draw_menu_item(uint8_t index, bool is_selected) {
    uint16_t pill_y = ITEM_Y_POSITIONS[index];
    uint16_t icon_y = ICON_Y_POSITIONS[index];
    uint16_t text_y = TEXT_Y_POSITIONS[index];

    if (is_selected) {
        // Draw the pill frame around this item
        tft.drawBitmap(20, pill_y, image_menu_selection_pill_bits, 260, 72, COLOR_ACCENT);
        tft.setTextColor(COLOR_TEXT_SEL);
    } else {
        // Clear pill area by drawing dark background in pill bounding box
        // (Only clear the outer perimeter and non-icon/text areas to be fast)
        tft.fillRect(20, pill_y, 260, 72, COLOR_BG);
        tft.setTextColor(COLOR_TEXT_UNSEL);
    }

    // Animation icon placeholder (static frame 0)
    tft.drawRect(27, icon_y, 48, 48, COLOR_GREY_INNER);

    // Item label
    tft.setTextSize(2);
    tft.drawString(MENU_LABELS[index], 110, text_y);
}

// ============================================================================
// FULL MAIN MENU RENDER (initial entry from Home)
// ============================================================================
void draw_main_menu_full(uint8_t selection_index) {
    if (selection_index > 2) selection_index = 0;

    // Fill screen with background
    tft.fillScreen(COLOR_BG);

    // Top Bar with margin lines, battery, network, date, time, back, info
    draw_topbar();

    // Scrollbar track (x=302, y=32, w=12, h=194)
    tft.fillRect(302, 32, 12, 194, COLOR_GREY_TRACK);
    tft.fillRect(304, 34, 7, 190, COLOR_GREY_INNER);

    // Scrollbar arrows at top and bottom
    tft.drawBitmap(301, 24, image_scrollbar_arrow_up_large, 14, 8, COLOR_GREY_TRACK);
    tft.drawBitmap(304, 30, image_scrollbar_arrow_up_small, 7, 4, COLOR_GREY_INNER);
    tft.drawBitmap(301, 226, image_scrollbar_arrow_dn_large, 14, 8, COLOR_GREY_TRACK);
    tft.drawBitmap(304, 224, image_scrollbar_arrow_dn_small, 7, 4, COLOR_GREY_INNER);

    // Draw all 3 items (unselected first, then selected)
    for (uint8_t i = 0; i < 3; i++) {
        draw_menu_item(i, i == selection_index);
    }

    // Draw scrollbar thumb
    draw_scrollbar_thumb(selection_index);
}

// ============================================================================
// PARTIAL MENU UPDATE (flicker-free selection movement)
// Only updates the old and new selected items and the scrollbar thumb!
// Zero fillScreen, zero full-screen redraw, zero flashing.
// ============================================================================
void draw_main_menu_update_selection(uint8_t old_index, uint8_t new_index) {
    if (old_index == new_index) return;
    if (old_index > 2) old_index = 0;
    if (new_index > 2) new_index = 0;

    // 1. Un-select old item (clear its pill and redraw text as unselected)
    draw_menu_item(old_index, false);

    // 2. Select new item (draw its pill and text as selected)
    draw_menu_item(new_index, true);

    // 3. Update scrollbar thumb: restore track over old thumb, draw new thumb
    uint16_t old_ty = THUMB_Y_POSITIONS[old_index];
    tft.fillRect(303, old_ty, 9, 15, COLOR_GREY_INNER);
    draw_scrollbar_thumb(new_index);
}

// ============================================================================
// SETTINGS SCREENS — LOPAKA GENERATED
// ============================================================================

// Settings selection pill bitmap (shared between Settings—Main and Settings—Display)
static const unsigned char PROGMEM image_settings_selection_pill_bits[] = {0x00,0xff,0xff,0xff,0xff,0xff,0xff,0xff,0xff,0xff,0xff,0xff,0xff,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0xf8,0x00};

// Settings menu item labels
static const char* SETTINGS_MAIN_LABELS[3] = { "Display", "Hype & Rest", "Pairing" };
static const char* SETTINGS_DISPLAY_LABELS[3] = { "Brightness", "Theme", "Home screen" };

// Generic settings item renderer (same logic as draw_menu_item, just parameterized labels)
static void draw_settings_item(uint8_t index, bool is_selected, const char* label) {
    uint16_t pill_y = ITEM_Y_POSITIONS[index];
    uint16_t icon_y = ICON_Y_POSITIONS[index];
    uint16_t text_y = TEXT_Y_POSITIONS[index];

    if (is_selected) {
        tft.drawBitmap(20, pill_y, image_menu_selection_pill_bits, 260, 72, COLOR_ACCENT);
        tft.setTextColor(COLOR_TEXT_SEL);
    } else {
        tft.fillRect(20, pill_y, 260, 72, COLOR_BG);
        tft.setTextColor(COLOR_TEXT_UNSEL);
    }

    // Animation icon placeholder (static frame 0)
    tft.drawRect(27, icon_y, 48, 48, COLOR_GREY_INNER);

    // Item label
    tft.setTextSize(2);
    tft.drawString(label, 110, text_y);
}

// Full Settings—Main render (initial entry)
void draw_settings_main(uint8_t selection_index) {
    if (selection_index > 2) selection_index = 0;

    tft.fillScreen(COLOR_BG);
    draw_topbar();

    // Scrollbar track and arrows
    tft.fillRect(302, 32, 12, 194, COLOR_GREY_TRACK);
    tft.fillRect(304, 34, 7, 190, COLOR_GREY_INNER);
    tft.drawBitmap(301, 24, image_scrollbar_arrow_up_large, 14, 8, COLOR_GREY_TRACK);
    tft.drawBitmap(304, 30, image_scrollbar_arrow_up_small, 7, 4, COLOR_GREY_INNER);
    tft.drawBitmap(301, 226, image_scrollbar_arrow_dn_large, 14, 8, COLOR_GREY_TRACK);
    tft.drawBitmap(304, 224, image_scrollbar_arrow_dn_small, 7, 4, COLOR_GREY_INNER);

    // Draw all 3 items
    for (uint8_t i = 0; i < 3; i++) {
        draw_settings_item(i, i == selection_index, SETTINGS_MAIN_LABELS[i]);
    }

    draw_scrollbar_thumb(selection_index);
}

// Fast in-place selection update for Settings—Main (zero flicker)
void draw_settings_main_update_selection(uint8_t old_index, uint8_t new_index) {
    if (old_index == new_index) return;
    if (old_index > 2) old_index = 0;
    if (new_index > 2) new_index = 0;

    draw_settings_item(old_index, false, SETTINGS_MAIN_LABELS[old_index]);
    draw_settings_item(new_index, true, SETTINGS_MAIN_LABELS[new_index]);

    uint16_t old_ty = THUMB_Y_POSITIONS[old_index];
    tft.fillRect(303, old_ty, 9, 15, COLOR_GREY_INNER);
    draw_scrollbar_thumb(new_index);
}

// Full Settings—Display render (initial entry)
void draw_settings_display(uint8_t selection_index) {
    if (selection_index > 2) selection_index = 0;

    tft.fillScreen(COLOR_BG);
    draw_topbar();

    // Scrollbar track and arrows
    tft.fillRect(302, 32, 12, 194, COLOR_GREY_TRACK);
    tft.fillRect(304, 34, 7, 190, COLOR_GREY_INNER);
    tft.drawBitmap(301, 24, image_scrollbar_arrow_up_large, 14, 8, COLOR_GREY_TRACK);
    tft.drawBitmap(304, 30, image_scrollbar_arrow_up_small, 7, 4, COLOR_GREY_INNER);
    tft.drawBitmap(301, 226, image_scrollbar_arrow_dn_large, 14, 8, COLOR_GREY_TRACK);
    tft.drawBitmap(304, 224, image_scrollbar_arrow_dn_small, 7, 4, COLOR_GREY_INNER);

    // Draw all 3 items
    for (uint8_t i = 0; i < 3; i++) {
        draw_settings_item(i, i == selection_index, SETTINGS_DISPLAY_LABELS[i]);
    }

    draw_scrollbar_thumb(selection_index);
}

// Fast in-place selection update for Settings—Display (zero flicker)
void draw_settings_display_update_selection(uint8_t old_index, uint8_t new_index) {
    if (old_index == new_index) return;
    if (old_index > 2) old_index = 0;
    if (new_index > 2) new_index = 0;

    draw_settings_item(old_index, false, SETTINGS_DISPLAY_LABELS[old_index]);
    draw_settings_item(new_index, true, SETTINGS_DISPLAY_LABELS[new_index]);

    uint16_t old_ty = THUMB_Y_POSITIONS[old_index];
    tft.fillRect(303, old_ty, 9, 15, COLOR_GREY_INNER);
    draw_scrollbar_thumb(new_index);
}

// ============================================================================
// ============================================================================
// SETTINGS—BRIGHTNESS SCREEN (LOPAKA GENERATED) - PIXEL PERFECT
// ============================================================================

// Brightness screen assets from Lopaka
static const unsigned char PROGMEM image_brightness_clock_quarters_bits[] = {0x07,0xc0,0x19,0x30,0x21,0x08,0x40,0x04,0x41,0x04,0x81,0x02,0x81,0x02,0xe1,0x0e,0x80,0x82,0x80,0x42,0x40,0x04,0x40,0x04,0x21,0x08,0x19,0x30,0x07,0xc0,0x00,0x00};
static const unsigned char PROGMEM image_brightness_slider_outline_bits[] = {0x03,0xff,0xff,0xff,0xff,0xff,0xff,0xff,0xff,0xff,0xff,0xff,0xff,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0xff,0xf0};
static const unsigned char PROGMEM image_brightness_settings_gear_bits[] = {0x03,0xc0,0x12,0x48,0x2c,0x34,0x40,0x02,0x23,0xc4,0x24,0x24,0xc8,0x13,0x88,0x11,0x88,0x11,0xc8,0x13,0x24,0x24,0x23,0xc4,0x40,0x02,0x2c,0x34,0x12,0x48,0x03,0xc0};
static const unsigned char PROGMEM image_brightness_headphones_bits[] = {0x07,0xc0,0x1e,0xf0,0x38,0x38,0x60,0x0c,0x40,0x04,0x80,0x02,0x80,0x02,0x80,0x02,0x60,0x0c,0x90,0x12,0x98,0x32,0xc8,0x26,0x44,0x44,0x64,0x4c,0x38,0x38,0x00,0x00};
static const unsigned char PROGMEM image_brightness_smartphone_bits[] = {0x7f,0x00,0xff,0x80,0x80,0x80,0x80,0x80,0x80,0x80,0x80,0x80,0x80,0x80,0x80,0x80,0x80,0x80,0x80,0x80,0x80,0x80,0x80,0x80,0x80,0x80,0xff,0x80,0xa2,0x80,0x7f,0x00};
static const unsigned char PROGMEM image_brightness_down_unselected_bits[] = {0x1f,0xff,0xfc,0x00,0x20,0x00,0x02,0x00,0x40,0x00,0x01,0x00,0x80,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0xfc,0x00};
static const unsigned char PROGMEM image_brightness_down_selected_bits[] = {0x1f,0xff,0xfc,0x00,0x3f,0xff,0xfe,0x00,0x7f,0xff,0xff,0x00,0xff,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0xfc,0x00};
static const unsigned char PROGMEM image_brightness_up_unselected_bits[] = {0x1f,0xff,0xfc,0x00,0x20,0x00,0x02,0x00,0x40,0x00,0x01,0x00,0x80,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0xfc,0x00};
static const unsigned char PROGMEM image_brightness_up_selected_bits[] = {0x1f,0xff,0xfc,0x00,0x3f,0xff,0xfe,0x00,0x7f,0xff,0xff,0x00,0xff,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0xfc,0x00};
static const unsigned char PROGMEM image_brightness_voltage_bits[] = {0x00,0x00,0x00,0x00,0x00,0x40,0x00,0xc0,0x01,0x80,0x03,0x80,0x07,0x00,0x0f,0xe0,0x01,0xc0,0x03,0x80,0x03,0x00,0x06,0x00,0x04,0x00,0x00,0x00,0x00,0x00,0x00,0x00};
static const unsigned char PROGMEM image_brightness_frost_bits[] = {0x01,0x00,0x13,0x90,0x31,0x18,0x73,0x9c,0x09,0x20,0x05,0x40,0x53,0x94,0xfe,0xfe,0x53,0x94,0x05,0x40,0x09,0x20,0x73,0x9c,0x31,0x18,0x13,0x90,0x01,0x00,0x00,0x00};

// Brightness change direction tracking (for icon highlighting)
enum BrightnessChangeDirection {
    BRIGHTNESS_NO_CHANGE = 0,
    BRIGHTNESS_INCREASING,
    BRIGHTNESS_DECREASING
};

// Internal helper with direction parameter
static void draw_settings_brightness_with_direction(uint8_t brightness_value, BrightnessChangeDirection direction) {
    if (brightness_value > 100) brightness_value = 100;

    tft.fillScreen(COLOR_BG);
    draw_topbar();

    // Sample text at different sizes (for visibility testing)
    tft.setTextColor(TFT_WHITE);
    tft.setTextSize(3);
    tft.drawString("Sample Text 1", 40, 40);
    tft.setTextSize(2);
    tft.drawString("Sample Text 2", 40, 71);
    tft.setTextSize(1);
    tft.drawString("Sample Text 1", 40, 95);

    // Animation placeholder
    tft.drawRect(220, 75, 64, 64, COLOR_GREY_TRACK);

    // Instructional text
    tft.setTextColor(COLOR_ACCENT);
    tft.drawString("Adjust brightness until visuals above", 44, 157);
    tft.drawString("are properly visible", 44, 169);

    // Sample icons
    tft.drawBitmap(39, 115, image_brightness_clock_quarters_bits, 15, 16, TFT_WHITE);
    tft.drawBitmap(70, 115, image_brightness_settings_gear_bits, 16, 16, COLOR_ACCENT);
    tft.drawBitmap(100, 115, image_brightness_headphones_bits, 15, 16, TFT_WHITE);
    tft.drawBitmap(130, 115, image_brightness_frost_bits, 15, 16, COLOR_GREY_TRACK);
    tft.drawBitmap(155, 114, image_brightness_voltage_bits, 16, 16, TFT_WHITE);
    tft.drawBitmap(180, 114, image_brightness_smartphone_bits, 9, 16, COLOR_ACCENT);

    // Clear and draw Down button
    tft.fillRect(36, 193, 25, 27, COLOR_BG);
    if (direction == BRIGHTNESS_DECREASING) {
        tft.drawBitmap(36, 193, image_brightness_down_selected_bits, 25, 27, COLOR_ACCENT);
    } else {
        tft.drawBitmap(36, 193, image_brightness_down_unselected_bits, 25, 27, TFT_WHITE);
    }

    // Slider fill: inner area (x=75, y=192, fill_width=0..168, h=28)
    int fill_width = (brightness_value * 168) / 100;
    if (fill_width > 0) {
        tft.fillRect(75, 192, fill_width, 28, COLOR_ACCENT);
    }

    // Slider outline (Layer_37) — drawn on top
    tft.drawBitmap(71, 190, image_brightness_slider_outline_bits, 176, 32, TFT_WHITE);

    // Clear and draw Up button
    tft.fillRect(257, 193, 25, 27, COLOR_BG);
    if (direction == BRIGHTNESS_INCREASING) {
        tft.drawBitmap(257, 193, image_brightness_up_selected_bits, 25, 27, COLOR_ACCENT);
    } else {
        tft.drawBitmap(257, 193, image_brightness_up_unselected_bits, 25, 27, TFT_WHITE);
    }

    // Border rect (optional decoration from Lopaka)
    tft.drawRect(30, 30, 260, 115, COLOR_GREY_TRACK);
}

// Public full render - no direction indicator (initial entry)
void draw_settings_brightness(uint8_t brightness_value) {
    draw_settings_brightness_with_direction(brightness_value, BRIGHTNESS_NO_CHANGE);
}

// Fast in-place update for brightness value change (zero flicker, no button overlap)
void draw_settings_brightness_update_value(uint8_t old_value, uint8_t new_value) {
    if (old_value == new_value) return;
    if (old_value > 100) old_value = 100;
    if (new_value > 100) new_value = 100;

    // Determine direction
    BrightnessChangeDirection direction = (new_value > old_value) ? BRIGHTNESS_INCREASING : BRIGHTNESS_DECREASING;

    // 1. Clear and redraw Down button (left)
    tft.fillRect(36, 193, 25, 27, COLOR_BG);
    if (direction == BRIGHTNESS_DECREASING) {
        tft.drawBitmap(36, 193, image_brightness_down_selected_bits, 25, 27, COLOR_ACCENT);
    } else {
        tft.drawBitmap(36, 193, image_brightness_down_unselected_bits, 25, 27, TFT_WHITE);
    }

    // 2. Cleanly clear the entire container area and redraw fill + outline cleanly
    // (Full inner width is 168px at x=75..243, y=192..220, h=28, container outline at 71,190)
    int fill_width = (new_value * 168) / 100;
    tft.fillRect(71, 190, 176, 32, COLOR_BG);
    if (fill_width > 0) {
        tft.fillRect(75, 192, fill_width, 28, COLOR_ACCENT);
    }
    tft.drawBitmap(71, 190, image_brightness_slider_outline_bits, 176, 32, TFT_WHITE);

    // 3. Clear and redraw Up button (right)
    tft.fillRect(257, 193, 25, 27, COLOR_BG);
    if (direction == BRIGHTNESS_INCREASING) {
        tft.drawBitmap(257, 193, image_brightness_up_selected_bits, 25, 27, COLOR_ACCENT);
    } else {
        tft.drawBitmap(257, 193, image_brightness_up_unselected_bits, 25, 27, TFT_WHITE);
    }
}

// ============================================================================
// Compatibility wrappers for direct calls
// ============================================================================
void draw_menu_1() { draw_main_menu_full(0); }
void draw_menu_2() { draw_main_menu_full(1); }
void draw_menu_3() { draw_main_menu_full(2); }
