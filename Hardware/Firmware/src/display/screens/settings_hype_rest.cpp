#include "../screens.h"
#include "../assets_common.h"
#include "../ui_primitives.h"
#include <TFT_eSPI.h>

extern TFT_eSPI tft;

// ============================================================================
// HYPE&REST SCREEN ASSETS (From Lopaka export)
// ============================================================================
static const unsigned char PROGMEM image_clock_quarters_bits[] = {0x07,0xc0,0x19,0x30,0x21,0x08,0x40,0x04,0x41,0x04,0x81,0x02,0x81,0x02,0xe1,0x0e,0x80,0x82,0x80,0x42,0x40,0x04,0x40,0x04,0x21,0x08,0x19,0x30,0x07,0xc0,0x00,0x00};
static const unsigned char PROGMEM image_music_bits[] = {0x00,0x7c,0x0f,0x84,0x08,0x04,0x08,0x7c,0x0f,0xc4,0x08,0x04,0x08,0x04,0x08,0x04,0x08,0x04,0x08,0x04,0x08,0x38,0x70,0x44,0x88,0x44,0x88,0x38,0x70,0x00,0x00,0x00};
static const uint16_t PROGMEM image_playlist_pill_selected_pixels[] = {0x0000,0x0000,0x0000,0x0000,0x3FE3,0x3FE3,0x3FE3,0x3FE3,0x3FE3,0x3FE3,0x3FE3,0x3FE3,0x3FE3,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0x0000,0x0000};
static const uint16_t PROGMEM image_playlist_pill_unselected_pixels[] = {0x0000,0x0000,0x0000,0xFFFF,0xFFFF,0xFFFF,0xFFFF,0xFFFF,0xFFFF,0xFFFF,0xFFFF,0xFFFF,0xFFFF,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0x0000,0x0000};
static const uint16_t PROGMEM image_tickbox_marked_pixels[] = {0x0000,0x0000,0x0000,0x0000,0x0000,0x0000,0x0000,0x0000,0x0000,0x0000,0x0000,0x0000,0x0000,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0x0000,0x0000};
static const uint16_t PROGMEM image_tickbox_unselected_unmarked_pixels[] = {0xFFFF,0xFFFF,0xFFFF,0xFFFF,0xFFFF,0xFFFF,0xFFFF,0xFFFF,0xFFFF,0xFFFF,0xFFFF,0xFFFF,0x0000,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0xFFFF,0xFFFF};
static const unsigned char PROGMEM image_tickbox_selected_unmarked_bits[] = {0xff,0xc0,0xc0,0xc0,0x80,0x40,0x80,0x40,0x80,0x40,0x80,0x40,0x80,0x40,0x80,0x40,0xc0,0xc0,0xff,0xc0};
static const uint16_t PROGMEM image_tickbox_selected_marked_pixels[] = {0x0000,0x0000,0x0000,0x0000,0x0000,0x0000,0x0000,0x0000,0x0000,0x0000,0x0000,0x0000,0x0000,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0x0000,0x0000};
static const unsigned char PROGMEM image_time_indicator_selected_bits[] = {0x20,0x70,0xf8,0x20,0x20,0x20,0x20,0xf8,0x70,0x20};
static const uint16_t PROGMEM image_time_indicator_unselected_pixels[] = {0x0000,0x0000,0xFFFF,0x0000,0x0000,0x0000,0xFFFF,0xFFFF,0xFFFF,0x0000,0xFFFF,0xFFFF,0xFFFF,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0x0000,0x0000};

// Dummy playlist names for Phase 1
static const char* dummy_playlists[] = {
    "Varjish",
    "Super chill",
    "Pump it up",
    "Focus Mode",
    "Beast Mode"
};
static const uint8_t NUM_PLAYLISTS = 5;

// ============================================================================
// INTERNAL HELPERS
// ============================================================================

// Convert time values to strings
static void format_time_value(char* buf, uint8_t value, size_t buf_size) {
    snprintf(buf, buf_size, "%d", value);
}

// Draw a tickbox (4 states: unmarked/marked × unselected/selected)
static void draw_tickbox(int16_t x, int16_t y, bool is_marked, bool is_selected) {
    tft.fillRect(x, y, 14, 12, COLOR_BG);
    if (is_selected && is_marked) {
        tft.pushImage(x, y, 14, 12, image_tickbox_selected_marked_pixels, (uint16_t)0x0000);
    } else if (is_selected && !is_marked) {
        // Offset by +2x, +1y to center the 10x10 bitmap within the 14x12 space
        tft.drawBitmap(x + 2, y + 1, image_tickbox_selected_unmarked_bits, 10, 10, 0xDB3E);
    } else if (!is_selected && is_marked) {
        tft.pushImage(x, y, 14, 12, image_tickbox_marked_pixels, (uint16_t)0x0000);
    } else {
        // Offset by +2x, +1y to center the 10x10 image within the 14x12 space
        tft.pushImage(x + 2, y + 1, 10, 10, image_tickbox_unselected_unmarked_pixels, (uint16_t)0x0000);
    }
}

// Draw a time indicator arrow
static void draw_time_indicator(int16_t x, int16_t y, bool is_selected) {
    tft.fillRect(x, y, 5, 10, COLOR_BG);
    if (is_selected) {
        tft.drawBitmap(x, y, image_time_indicator_selected_bits, 5, 10, COLOR_ACCENT);
    } else {
        tft.pushImage(x, y, 5, 10, image_time_indicator_unselected_pixels, (uint16_t)0x0000);
    }
}

// Draw a playlist pill
static void draw_playlist_pill(int16_t x, int16_t y, const char* playlist_name, bool is_selected) {
    tft.fillRect(x, y, 115, 17, COLOR_BG);
    if (is_selected) {
        tft.pushImage(x, y, 115, 17, image_playlist_pill_selected_pixels, (uint16_t)0x0000);
    } else {
        tft.pushImage(x, y, 115, 16, image_playlist_pill_unselected_pixels, (uint16_t)0x0000);
    }
    tft.setTextColor(TFT_WHITE);
    tft.setTextSize(1);
    tft.drawString(playlist_name, x + 5, y + 5);
}

// ============================================================================
// PUBLIC API
// ============================================================================

// Global state reference (defined in app_task.cpp)
extern HypeRestState g_hype_rest_state;

void draw_settings_hype_rest_full() {
    const HypeRestState& state = g_hype_rest_state;
    char buf[8];

    // Background
    tft.fillScreen(COLOR_BG);
    draw_topbar();

    // === HYPE SECTION ===
    tft.setTextColor(TFT_WHITE);
    tft.setTextSize(2);
    tft.drawString("Hype:", 20, 33);

    // Time label
    tft.setTextSize(1);
    tft.drawString("Time:", 90, 74);

    // Playlist label
    tft.drawString("Playlist:", 90, 110);

    // Exercise based time label
    tft.drawString("Exercise based time", 143, 47);

    // Clock icon
    tft.drawBitmap(63, 70, image_clock_quarters_bits, 15, 16, TFT_WHITE);

    // Music icon
    tft.drawBitmap(63, 105, image_music_bits, 14, 16, TFT_WHITE);

    // Hype checkbox (item 0)
    draw_tickbox(125, 45, state.hype_exercise_based_time, state.selected_item == 0);

    // Hype minutes (item 1)
    draw_time_indicator(125, 73, state.selected_item == 1);
    format_time_value(buf, state.hype_minutes, sizeof(buf));
    tft.setTextColor(TFT_WHITE);
    tft.drawString(buf, 135, 74);
    tft.setTextColor(state.selected_item == 1 && state.edit_mode ? COLOR_ACCENT : COLOR_GREY_TRACK);
    tft.drawString("Minute(s)", 145, 74);

    // Hype seconds (item 2)
    draw_time_indicator(202, 73, state.selected_item == 2);
    format_time_value(buf, state.hype_seconds, sizeof(buf));
    tft.setTextColor(TFT_WHITE);
    tft.drawString(buf, 213, 74);
    tft.setTextColor(state.selected_item == 2 && state.edit_mode ? COLOR_ACCENT : COLOR_GREY_TRACK);
    tft.drawString("Second(s)", 231, 74);

    // Hype playlist (item 3)
    draw_time_indicator(280, 107, state.selected_item == 3);
    draw_playlist_pill(160, 104, dummy_playlists[state.hype_playlist_index], state.selected_item == 3);

    // === REST SECTION ===
    tft.setTextColor(TFT_WHITE);
    tft.setTextSize(2);
    tft.drawString("Rest:", 20, 135);

    // Time label
    tft.setTextSize(1);
    tft.drawString("Time:", 90, 176);

    // Playlist label
    tft.drawString("Playlist:", 90, 212);

    // Exercise based time label
    tft.drawString("Exercise based time", 143, 149);

    // Clock icon
    tft.drawBitmap(63, 172, image_clock_quarters_bits, 15, 16, TFT_WHITE);

    // Music icon
    tft.drawBitmap(63, 207, image_music_bits, 14, 16, TFT_WHITE);

    // Rest checkbox (item 4)
    draw_tickbox(125, 146, state.rest_exercise_based_time, state.selected_item == 4);

    // Rest minutes (item 5)
    draw_time_indicator(125, 175, state.selected_item == 5);
    format_time_value(buf, state.rest_minutes, sizeof(buf));
    tft.setTextColor(TFT_WHITE);
    tft.drawString(buf, 135, 176);
    tft.setTextColor(state.selected_item == 5 && state.edit_mode ? COLOR_ACCENT : COLOR_GREY_TRACK);
    tft.drawString("Minute(s)", 145, 176);

    // Rest seconds (item 6)
    draw_time_indicator(203, 175, state.selected_item == 6);
    format_time_value(buf, state.rest_seconds, sizeof(buf));
    tft.setTextColor(TFT_WHITE);
    tft.drawString(buf, 213, 176);
    tft.setTextColor(state.selected_item == 6 && state.edit_mode ? COLOR_ACCENT : COLOR_GREY_TRACK);
    tft.drawString("Second(s)", 231, 176);

    // Rest playlist (item 7)
    draw_time_indicator(280, 210, state.selected_item == 7);
    draw_playlist_pill(160, 207, dummy_playlists[state.rest_playlist_index], state.selected_item == 7);
}

// Redraw only a single item by index (flicker-free dirty rect update)
void draw_settings_hype_rest_item(uint8_t item_index) {
    const HypeRestState& state = g_hype_rest_state;
    char buf[8];
    tft.setTextSize(1);
    tft.setTextDatum(TL_DATUM);

    switch (item_index) {
        case 0: // Hype checkbox
            draw_tickbox(125, 45, state.hype_exercise_based_time, state.selected_item == 0);
            break;
        case 1: // Hype minutes
            draw_time_indicator(125, 73, state.selected_item == 1);
            tft.fillRect(135, 74, 20, 10, COLOR_BG);
            format_time_value(buf, state.hype_minutes, sizeof(buf));
            tft.setTextColor(TFT_WHITE, COLOR_BG);
            tft.drawString(buf, 135, 74);
            tft.setTextColor(state.selected_item == 1 && state.edit_mode ? COLOR_ACCENT : COLOR_GREY_TRACK, COLOR_BG);
            tft.drawString("Minute(s)", 145, 74);
            break;
        case 2: // Hype seconds
            draw_time_indicator(202, 73, state.selected_item == 2);
            tft.fillRect(213, 74, 18, 10, COLOR_BG);
            format_time_value(buf, state.hype_seconds, sizeof(buf));
            tft.setTextColor(TFT_WHITE, COLOR_BG);
            tft.drawString(buf, 213, 74);
            tft.setTextColor(state.selected_item == 2 && state.edit_mode ? COLOR_ACCENT : COLOR_GREY_TRACK, COLOR_BG);
            tft.drawString("Second(s)", 231, 74);
            break;
        case 3: // Hype playlist
            draw_time_indicator(280, 107, state.selected_item == 3);
            draw_playlist_pill(160, 104, dummy_playlists[state.hype_playlist_index], state.selected_item == 3);
            break;
        case 4: // Rest checkbox
            draw_tickbox(125, 146, state.rest_exercise_based_time, state.selected_item == 4);
            break;
        case 5: // Rest minutes
            draw_time_indicator(125, 175, state.selected_item == 5);
            tft.fillRect(135, 176, 20, 10, COLOR_BG);
            format_time_value(buf, state.rest_minutes, sizeof(buf));
            tft.setTextColor(TFT_WHITE, COLOR_BG);
            tft.drawString(buf, 135, 176);
            tft.setTextColor(state.selected_item == 5 && state.edit_mode ? COLOR_ACCENT : COLOR_GREY_TRACK, COLOR_BG);
            tft.drawString("Minute(s)", 145, 176);
            break;
        case 6: // Rest seconds
            draw_time_indicator(203, 175, state.selected_item == 6);
            tft.fillRect(213, 176, 18, 10, COLOR_BG);
            format_time_value(buf, state.rest_seconds, sizeof(buf));
            tft.setTextColor(TFT_WHITE, COLOR_BG);
            tft.drawString(buf, 213, 176);
            tft.setTextColor(state.selected_item == 6 && state.edit_mode ? COLOR_ACCENT : COLOR_GREY_TRACK, COLOR_BG);
            tft.drawString("Second(s)", 231, 176);
            break;
        case 7: // Rest playlist
            draw_time_indicator(280, 210, state.selected_item == 7);
            draw_playlist_pill(160, 207, dummy_playlists[state.rest_playlist_index], state.selected_item == 7);
            break;
        default:
            break;
    }
}

