#include "../screens.h"
#include "../assets_common.h"
#include "../ui_primitives.h"
#include <TFT_eSPI.h>

extern TFT_eSPI tft;

// ============================================================================
// BRIGHTNESS SCREEN ASSETS (Self-contained)
// ============================================================================
static const unsigned char PROGMEM image_brightness_clock_quarters_bits[] = {0x07,0xc0,0x19,0x30,0x21,0x08,0x40,0x04,0x41,0x04,0x81,0x02,0x81,0x02,0xe1,0x0e,0x80,0x82,0x80,0x42,0x40,0x04,0x40,0x04,0x21,0x08,0x19,0x30,0x07,0xc0,0x00,0x00};
static const unsigned char PROGMEM image_brightness_slider_outline_bits[] = {0x03,0xff,0xff,0xff,0xff,0xff,0xff,0xff,0xff,0xff,0xff,0xff,0xff,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0xff,0xf0};
static const unsigned char PROGMEM image_brightness_settings_gear_bits[] = {0x03,0xc0,0x12,0x48,0x2c,0x34,0x40,0x02,0x23,0xc4,0x24,0x24,0xc8,0x13,0x88,0x11,0x88,0x11,0xc8,0x13,0x24,0x24,0x23,0xc4,0x40,0x02,0x2c,0x34,0x12,0x48,0x03,0xc0};
static const unsigned char PROGMEM image_brightness_headphones_bits[] = {0x07,0xc0,0x1e,0xf0,0x38,0x38,0x60,0x0c,0x40,0x04,0x80,0x02,0x80,0x02,0x80,0x02,0x60,0x0c,0x90,0x12,0x98,0x32,0xc8,0x26,0x44,0x44,0x64,0x4c,0x38,0x38,0x00,0x00};
static const unsigned char PROGMEM image_brightness_smartphone_bits[] = {0x7f,0x00,0xff,0x80,0x80,0x80,0x80,0x80,0x80,0x80,0x80,0x80,0x80,0x80,0x80,0x80,0x80,0x80,0x80,0x80,0x80,0x80,0x80,0x80,0x80,0x80,0xff,0x80,0xa2,0x80,0x7f,0x00};
static const unsigned char PROGMEM image_brightness_down_unselected_bits[] = {0x1f,0xff,0xfc,0x00,0x20,0x00,0x02,0x00,0x40,0x00,0x01,0x00,0x80,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0xfc,0x00};
static const unsigned char PROGMEM image_brightness_down_selected_bits[] = {0x1f,0xff,0xfc,0x00,0x3f,0xff,0xfe,0x00,0x7f,0xff,0xff,0x00,0xff,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0xfc,0x00};
static const unsigned char PROGMEM image_brightness_up_unselected_bits[] = {0x1f,0xff,0xfc,0x00,0x20,0x00,0x02,0x00,0x40,0x00,0x01,0x00,0x80,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0xfc,0x00};
static const unsigned char PROGMEM image_brightness_up_selected_bits[] = {0x1f,0xff,0xfc,0x00,0x3f,0xff,0xfe,0x00,0x7f,0xff,0xff,0x00,0xff,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0xfc,0x00};
static const unsigned char PROGMEM image_brightness_voltage_bits[] = {0x00,0x00,0x00,0x00,0x00,0x40,0x00,0xc0,0x01,0x80,0x03,0x80,0x07,0x00,0x0f,0xe0,0x01,0xc0,0x03,0x80,0x03,0x00,0x06,0x00,0x04,0x00,0x00,0x00,0x00,0x00,0x00,0x00};
static const unsigned char PROGMEM image_brightness_frost_bits[] = {0x01,0x00,0x13,0x90,0x31,0x18,0x73,0x9c,0x09,0x20,0x05,0x40,0x53,0x94,0xfe,0xfe,0x53,0x94,0x05,0x40,0x09,0x20,0x73,0x9c,0x31,0x18,0x13,0x90,0x01,0x00,0x00,0x00};

// Brightness change direction tracking (for icon highlighting)
enum BrightnessChangeDirection {
    BRIGHTNESS_NO_CHANGE = 0,
    BRIGHTNESS_INCREASING,
    BRIGHTNESS_DECREASING
};

// Internal helper with direction parameter
static void draw_settings_brightness_with_direction(uint8_t brightness_value, BrightnessChangeDirection direction) {
    if (brightness_value > 100) brightness_value = 100;

    tft.fillScreen(COLOR_BG);
    draw_topbar();

    // Sample text at different sizes (for visibility testing)
    tft.setTextColor(TFT_WHITE);
    tft.setTextSize(3);
    tft.drawString("Sample Text 1", 40, 40);
    tft.setTextSize(2);
    tft.drawString("Sample Text 2", 40, 71);
    tft.setTextSize(1);
    tft.drawString("Sample Text 1", 40, 95);

    // Animation placeholder
    tft.drawRect(220, 75, 64, 64, COLOR_GREY_TRACK);

    // Instructional text
    tft.setTextColor(COLOR_ACCENT);
    tft.drawString("Adjust brightness until visuals above", 44, 157);
    tft.drawString("are properly visible", 44, 169);

    // Sample icons
    tft.drawBitmap(39, 115, image_brightness_clock_quarters_bits, 15, 16, TFT_WHITE);
    tft.drawBitmap(70, 115, image_brightness_settings_gear_bits, 16, 16, COLOR_ACCENT);
    tft.drawBitmap(100, 115, image_brightness_headphones_bits, 15, 16, TFT_WHITE);
    tft.drawBitmap(130, 115, image_brightness_frost_bits, 15, 16, COLOR_GREY_TRACK);
    tft.drawBitmap(155, 114, image_brightness_voltage_bits, 16, 16, TFT_WHITE);
    tft.drawBitmap(180, 114, image_brightness_smartphone_bits, 9, 16, COLOR_ACCENT);

    // Clear and draw Down button
    tft.fillRect(36, 193, 25, 27, COLOR_BG);
    if (direction == BRIGHTNESS_DECREASING) {
        tft.drawBitmap(36, 193, image_brightness_down_selected_bits, 25, 27, COLOR_ACCENT);
    } else {
        tft.drawBitmap(36, 193, image_brightness_down_unselected_bits, 25, 27, TFT_WHITE);
    }

    // Slider fill: inner area (x=75, y=192, fill_width=0..168, h=28)
    int fill_width = (brightness_value * 168) / 100;
    if (fill_width > 0) {
        tft.fillRect(75, 192, fill_width, 28, COLOR_ACCENT);
    }

    // Slider outline (Layer_37) — drawn on top
    tft.drawBitmap(71, 190, image_brightness_slider_outline_bits, 176, 32, TFT_WHITE);

    // Clear and draw Up button
    tft.fillRect(257, 193, 25, 27, COLOR_BG);
    if (direction == BRIGHTNESS_INCREASING) {
        tft.drawBitmap(257, 193, image_brightness_up_selected_bits, 25, 27, COLOR_ACCENT);
    } else {
        tft.drawBitmap(257, 193, image_brightness_up_unselected_bits, 25, 27, TFT_WHITE);
    }

    // Border rect (optional decoration from Lopaka)
    tft.drawRect(30, 30, 260, 115, COLOR_GREY_TRACK);
}

// Public full render - no direction indicator (initial entry)
void draw_settings_brightness(uint8_t brightness_value) {
    draw_settings_brightness_with_direction(brightness_value, BRIGHTNESS_NO_CHANGE);
}

// Fast in-place update for brightness value change (zero flicker, no button overlap)
void draw_settings_brightness_update_value(uint8_t old_value, uint8_t new_value) {
    if (old_value == new_value) return;
    if (old_value > 100) old_value = 100;
    if (new_value > 100) new_value = 100;

    // Determine direction
    BrightnessChangeDirection direction = (new_value > old_value) ? BRIGHTNESS_INCREASING : BRIGHTNESS_DECREASING;

    // 1. Clear and redraw Down button (left)
    tft.fillRect(36, 193, 25, 27, COLOR_BG);
    if (direction == BRIGHTNESS_DECREASING) {
        tft.drawBitmap(36, 193, image_brightness_down_selected_bits, 25, 27, COLOR_ACCENT);
    } else {
        tft.drawBitmap(36, 193, image_brightness_down_unselected_bits, 25, 27, TFT_WHITE);
    }

    // 2. Cleanly clear the entire container area and redraw fill + outline cleanly
    int fill_width = (new_value * 168) / 100;
    tft.fillRect(71, 190, 176, 32, COLOR_BG);
    if (fill_width > 0) {
        tft.fillRect(75, 192, fill_width, 28, COLOR_ACCENT);
    }
    tft.drawBitmap(71, 190, image_brightness_slider_outline_bits, 176, 32, TFT_WHITE);

    // 3. Clear and redraw Up button (right)
    tft.fillRect(257, 193, 25, 27, COLOR_BG);
    if (direction == BRIGHTNESS_INCREASING) {
        tft.drawBitmap(257, 193, image_brightness_up_selected_bits, 25, 27, COLOR_ACCENT);
    } else {
        tft.drawBitmap(257, 193, image_brightness_up_unselected_bits, 25, 27, TFT_WHITE);
    }
}
